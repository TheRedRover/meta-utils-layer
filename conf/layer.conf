## conf/layer.conf
```bitbake
# We have a conf and classes directory, add to BBPATH
BBPATH .= ":${LAYERDIR}"

# We have recipes-* directories, add to BBFILES
BBFILES += "${LAYERDIR}/recipes-*/*/*.bb \
            ${LAYERDIR}/recipes-*/*/*.bbappend"

BBFILE_COLLECTIONS += "meta-custom-utils"
BBFILE_PATTERN_meta-custom-utils = "^${LAYERDIR}/"
BBFILE_PRIORITY_meta-custom-utils = "6"

LAYERDEPENDS_meta-custom-utils = "core"
LAYERSERIES_COMPAT_meta-custom-utils = "kirkstone"
```
